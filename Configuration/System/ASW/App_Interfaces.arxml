AUTOSAR XML (schema 4-3-0)
package /App_Interfaces
  client server interface If_TestInterface
    operation TestOperation
      arg ledOn: type=boolean, direction=IN
      arg magicNumber: type=uint32, direction=INOUT
